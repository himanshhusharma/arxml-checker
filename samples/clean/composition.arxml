AUTOSAR XML (schema 4-3-0)
package /Compositions
  composition sw component type VehicleComposition
    4 x component:
      SpeedSensor_0: type=SpeedSensor
      EngineMonitor_0: type=EngineMonitor
      OverspeedMonitor_0: type=OverspeedMonitor
      Cluster_0: type=Cluster
    connect SpeedSensor_0.VehicleSpeed -> OverspeedMonitor_0.VehicleSpeed
    connect EngineMonitor_0.EngineSpeed -> OverspeedMonitor_0.EngineSpeed
    connect OverspeedMonitor_0.Overspeed -> Cluster_0.Overspeed
