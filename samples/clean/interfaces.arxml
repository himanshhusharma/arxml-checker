AUTOSAR XML (schema 4-3-0)
package /Interfaces
  sender receiver interface VehicleSpeed_If
    data Speed: type=Speed_kmph
  sender receiver interface EngineSpeed_If
    data Rpm: type=Rpm
  sender receiver interface Overspeed_If
    data Warning: type=Boolean
