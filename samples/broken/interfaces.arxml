AUTOSAR XML (schema 4-3-0)
package /Interfaces
  5 x sender receiver interface:
    VehicleSpeed_If
      data Speed: type=Speed_kmph
    EngineSpeed_If
      data Rpm: type=Rpm
    Overspeed_If
      data Warning: type=Boolean
    VehicleSpeedRaw_If
      data Speed: type=uint16
    CoolantTemp_If
      data Temp: type=Temperature_degC
