AUTOSAR XML (schema 4-3-0)
standard types defined: uint16
package /DataTypes
  app type Speed_kmph: category=VALUE
  app type Rpm: category=VALUE
  app type Boolean: category=VALUE
